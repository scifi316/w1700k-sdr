## platform/dumper/an7581_w1700k_dumper_defconfig
```kconfig
# SPDX-License-Identifier: GPL-2.0+
CONFIG_ARM=y
CONFIG_ARCH_AIROHA=y
CONFIG_TARGET_AN7581=y
CONFIG_AN7581_W1700K_SDR=y
CONFIG_POSITION_INDEPENDENT=y
CONFIG_TEXT_BASE=0x80200000
CONFIG_SYS_MALLOC_F_LEN=0x4000
CONFIG_SYS_MALLOC_LEN=0x400000
CONFIG_NR_DRAM_BANKS=1
CONFIG_ENV_SIZE=0x4000
CONFIG_DEFAULT_DEVICE_TREE="airoha/an7581-w1700k-dumper"
CONFIG_SYS_LOAD_ADDR=0x90000000
CONFIG_BUILD_TARGET="u-boot.bin"
CONFIG_FIT=y
CONFIG_FIT_VERBOSE=y
# LZMA lets the dumper boot a compressed FIT such as the loader; it adds no
# NAND write path.
CONFIG_LZMA=y
# CONFIG_BOOTSTD is not set
# CONFIG_AUTOBOOT is not set
# CONFIG_EFI_LOADER is not set
# CONFIG_EXPO is not set
# CONFIG_DISPLAY_BOARDINFO is not set
CONFIG_HUSH_PARSER=y
CONFIG_SYS_PROMPT="dumper> "
CONFIG_SYS_MAXARGS=16
CONFIG_CMD_BDI=y
CONFIG_CMD_BDINFO_EXTRA=y
CONFIG_CMD_IMI=y
CONFIG_CMD_FDT=y
CONFIG_CMD_DM=y
CONFIG_CMD_MTD=y
CONFIG_CMD_HASH=y
CONFIG_HASH=y
CONFIG_SHA256=y
# CONFIG_CMD_UBI is not set
# CONFIG_CMD_BOOTEFI is not set
# CONFIG_CMD_BOOTI is not set
# CONFIG_BOOTM_PLAN9 is not set
# CONFIG_BOOTM_RTEMS is not set
# CONFIG_BOOTM_VXWORKS is not set
# CONFIG_CMD_ELF is not set
# CONFIG_CMD_GO is not set
# CONFIG_CMD_XIMG is not set
# CONFIG_CMD_EDITENV is not set
# CONFIG_CMD_SAVEENV is not set
# CONFIG_CMD_MTD_MARKBAD is not set
# CONFIG_CMD_MTD_NAND_WRITE_TEST is not set
# CONFIG_CMD_MTD_OTP is not set
CONFIG_CMD_PING=y
CONFIG_CMD_TFTPBOOT=y
CONFIG_CMD_TFTPPUT=y
CONFIG_TFTP_WINDOWSIZE=8
CONFIG_OF_UPSTREAM=y
CONFIG_ENV_IS_NOWHERE=y
# CONFIG_ENV_IS_IN_MTD is not set
CONFIG_ENV_RELOC_GD_ENV_ADDR=y
CONFIG_ENV_USE_DEFAULT_ENV_TEXT_FILE=y
CONFIG_ENV_DEFAULT_ENV_TEXT_FILE="defenvs/an7581_w1700k_dumper_env"
CONFIG_NET_RANDOM_ETHADDR=y
CONFIG_SYS_RX_ETH_BUFFER=8
CONFIG_REGMAP=y
CONFIG_SYSCON=y
CONFIG_CLK=y
CONFIG_DMA=y
CONFIG_DM_GPIO=y
CONFIG_AIROHA_ETH=y
CONFIG_DM_MDIO=y
CONFIG_PHY=y
CONFIG_PINCTRL=y
CONFIG_PINCONF=y
CONFIG_POWER_DOMAIN=y
CONFIG_DM_SERIAL=y
CONFIG_SYS_NS16550=y
CONFIG_SERIAL_RX_BUFFER=y
CONFIG_SERIAL_RX_BUFFER_SIZE=256
# CONFIG_MMC is not set
CONFIG_MTD=y
CONFIG_DM_MTD=y
CONFIG_MTD_SPI_NAND=y
CONFIG_MTD_SPI_NAND_READ_ONLY=y
# The vendor BBT/BMT translation, read side only.
CONFIG_AIROHA_BMT=y
# CONFIG_MTD_UBI is not set
# CONFIG_UBI_BLOCK is not set
CONFIG_SPI=y
CONFIG_DM_SPI=y
CONFIG_AIROHA_SNFI_SPI=y
# CONFIG_PCI is not set
# CONFIG_USB is not set
# CONFIG_TOOLS_LIBCRYPTO is not set
# CONFIG_TOOLS_MKEFICAPSULE is not set
# CONFIG_TOOLS_KWBIMAGE is not set
```

## platform/loader/an7581_w1700k_sdr_defconfig
```kconfig
# SPDX-License-Identifier: GPL-2.0+
CONFIG_ARM=y
CONFIG_ARCH_AIROHA=y
CONFIG_TARGET_AN7581=y
CONFIG_AN7581_W1700K_SDR=y
CONFIG_POSITION_INDEPENDENT=y
CONFIG_TEXT_BASE=0x80200000
CONFIG_SYS_MALLOC_F_LEN=0x4000
CONFIG_NR_DRAM_BANKS=1
CONFIG_ENV_SIZE=0x4000
CONFIG_DEFAULT_DEVICE_TREE="airoha/an7581-w1700k-sdr-loader"
CONFIG_SYS_LOAD_ADDR=0x81800000
CONFIG_BUILD_TARGET="u-boot.bin"
CONFIG_FIT=y
CONFIG_FIT_VERBOSE=y
# CONFIG_BOOTSTD is not set
CONFIG_AUTOBOOT=y
CONFIG_BOOTDELAY=5
CONFIG_BOOTCOUNT_LIMIT=y
CONFIG_BOOTCOUNT_ENV=y
# CONFIG_EFI_LOADER is not set
# CONFIG_EXPO is not set
# CONFIG_DISPLAY_BOARDINFO is not set
CONFIG_HUSH_PARSER=y
CONFIG_SYS_PROMPT="SDR loader> "
CONFIG_SYS_MAXARGS=16
CONFIG_CMD_BDI=y
CONFIG_CMD_BDINFO_EXTRA=y
CONFIG_CMD_IMI=y
CONFIG_CMD_BOOTI=y
CONFIG_CMD_FDT=y
CONFIG_CMD_MTD=y
CONFIG_CMD_UBI=y
# CONFIG_CMD_BOOTEFI is not set
# CONFIG_BOOTM_PLAN9 is not set
# CONFIG_BOOTM_RTEMS is not set
# CONFIG_BOOTM_VXWORKS is not set
# CONFIG_CMD_ELF is not set
# CONFIG_CMD_GO is not set
# CONFIG_CMD_XIMG is not set
CONFIG_CMD_EDITENV=y
CONFIG_CMD_SAVEENV=y
CONFIG_CMD_PING=y
CONFIG_CMD_TFTPBOOT=y
CONFIG_CMD_TFTPPUT=y
# One block per acknowledgement: at line rate a window of 8 overruns the
# driver's eight receive buffers (window 1: about 20 MiB/s).
CONFIG_TFTP_WINDOWSIZE=1
CONFIG_CMD_HASH=y
CONFIG_HASH=y
CONFIG_OF_UPSTREAM=y
# CONFIG_ENV_IS_NOWHERE is not set
# CONFIG_ENV_IS_IN_MTD is not set
CONFIG_ENV_IS_IN_UBI=y
CONFIG_ENV_REDUNDANT=y
CONFIG_ENV_UBI_PART="system"
CONFIG_ENV_UBI_VOLUME="ubootenv"
CONFIG_ENV_UBI_VOLUME_REDUND="ubootenv2"
CONFIG_ENV_UBI_VID_OFFSET=0
CONFIG_ENV_RELOC_GD_ENV_ADDR=y
CONFIG_ENV_USE_DEFAULT_ENV_TEXT_FILE=y
CONFIG_ENV_DEFAULT_ENV_TEXT_FILE="defenvs/an7581_w1700k_sdr_env"
CONFIG_NET_RANDOM_ETHADDR=y
CONFIG_SYS_RX_ETH_BUFFER=8
CONFIG_REGMAP=y
CONFIG_SYSCON=y
CONFIG_CLK=y
CONFIG_DMA=y
CONFIG_DM_GPIO=y
CONFIG_AIROHA_ETH=y
CONFIG_DM_MDIO=y
CONFIG_PHY=y
CONFIG_PINCTRL=y
CONFIG_PINCONF=y
CONFIG_POWER_DOMAIN=y
CONFIG_DM_SERIAL=y
CONFIG_SYS_NS16550=y
CONFIG_SERIAL_RX_BUFFER=y
CONFIG_SERIAL_RX_BUFFER_SIZE=256
# CONFIG_MMC is not set
CONFIG_MTD=y
CONFIG_DM_MTD=y
CONFIG_MTD_SPI_NAND=y
CONFIG_AIROHA_BMT=y
CONFIG_AIROHA_BMT_WRITE=y
CONFIG_MTD_UBI=y
CONFIG_UBI_BLOCK=y
CONFIG_SPI=y
CONFIG_DM_SPI=y
CONFIG_AIROHA_SNFI_SPI=y
# CONFIG_PCI is not set
# CONFIG_USB is not set
# CONFIG_TOOLS_LIBCRYPTO is not set
# CONFIG_TOOLS_MKEFICAPSULE is not set
# CONFIG_TOOLS_KWBIMAGE is not set
```

## platform/restorer/an7581_w1700k_restorer_defconfig
```kconfig
# SPDX-License-Identifier: GPL-2.0+
CONFIG_ARM=y
CONFIG_ARCH_AIROHA=y
CONFIG_TARGET_AN7581=y
CONFIG_AN7581_W1700K_SDR=y
CONFIG_POSITION_INDEPENDENT=y
CONFIG_TEXT_BASE=0x80200000
CONFIG_SYS_MALLOC_F_LEN=0x4000
CONFIG_SYS_MALLOC_LEN=0x400000
CONFIG_NR_DRAM_BANKS=1
CONFIG_ENV_SIZE=0x4000
CONFIG_DEFAULT_DEVICE_TREE="airoha/an7581-w1700k-dumper"
CONFIG_SYS_LOAD_ADDR=0x90000000
CONFIG_BUILD_TARGET="u-boot.bin"
CONFIG_FIT=y
CONFIG_FIT_VERBOSE=y
# CONFIG_BOOTSTD is not set
# CONFIG_AUTOBOOT is not set
# CONFIG_EFI_LOADER is not set
# CONFIG_EXPO is not set
# CONFIG_DISPLAY_BOARDINFO is not set
CONFIG_HUSH_PARSER=y
CONFIG_SYS_PROMPT="restore> "
CONFIG_SYS_MAXARGS=16
CONFIG_CMD_BDI=y
CONFIG_CMD_BDINFO_EXTRA=y
CONFIG_CMD_IMI=y
CONFIG_CMD_FDT=y
CONFIG_CMD_DM=y
CONFIG_CMD_MTD=y
CONFIG_CMD_HASH=y
# The backup arrives gzip-compressed and is unpacked into the backup buffer.
CONFIG_CMD_UNZIP=y
# The block-by-block writer init/restore drives.
CONFIG_CMD_NANDSYNC=y
CONFIG_HASH=y
CONFIG_SHA256=y
# CONFIG_CMD_UBI is not set
# CONFIG_CMD_BOOTEFI is not set
# CONFIG_CMD_BOOTI is not set
# CONFIG_BOOTM_PLAN9 is not set
# CONFIG_BOOTM_RTEMS is not set
# CONFIG_BOOTM_VXWORKS is not set
# CONFIG_CMD_ELF is not set
# CONFIG_CMD_GO is not set
# CONFIG_CMD_XIMG is not set
# CONFIG_CMD_EDITENV is not set
# CONFIG_CMD_SAVEENV is not set
# CONFIG_CMD_MTD_MARKBAD is not set
# CONFIG_CMD_MTD_NAND_WRITE_TEST is not set
# CONFIG_CMD_MTD_OTP is not set
CONFIG_CMD_PING=y
CONFIG_CMD_TFTPBOOT=y
# One block per acknowledgement: at line rate a window of 8 overruns the
# driver's eight receive buffers (window 1: about 20 MiB/s).
CONFIG_TFTP_WINDOWSIZE=1
CONFIG_OF_UPSTREAM=y
CONFIG_ENV_IS_NOWHERE=y
# CONFIG_ENV_IS_IN_MTD is not set
CONFIG_ENV_RELOC_GD_ENV_ADDR=y
CONFIG_ENV_USE_DEFAULT_ENV_TEXT_FILE=y
CONFIG_ENV_DEFAULT_ENV_TEXT_FILE="defenvs/an7581_w1700k_restorer_env"
CONFIG_NET_RANDOM_ETHADDR=y
CONFIG_SYS_RX_ETH_BUFFER=8
CONFIG_REGMAP=y
CONFIG_SYSCON=y
CONFIG_CLK=y
CONFIG_DMA=y
CONFIG_DM_GPIO=y
CONFIG_AIROHA_ETH=y
CONFIG_DM_MDIO=y
CONFIG_PHY=y
CONFIG_PINCTRL=y
CONFIG_PINCONF=y
CONFIG_POWER_DOMAIN=y
CONFIG_DM_SERIAL=y
CONFIG_SYS_NS16550=y
CONFIG_SERIAL_RX_BUFFER=y
CONFIG_SERIAL_RX_BUFFER_SIZE=256
# CONFIG_MMC is not set
CONFIG_MTD=y
CONFIG_DM_MTD=y
CONFIG_MTD_SPI_NAND=y
# Writes go through the vendor BBT/BMT translation and its replacement engine.
CONFIG_AIROHA_BMT=y
CONFIG_AIROHA_BMT_WRITE=y
# CONFIG_MTD_UBI is not set
# CONFIG_UBI_BLOCK is not set
CONFIG_SPI=y
CONFIG_DM_SPI=y
CONFIG_AIROHA_SNFI_SPI=y
# CONFIG_PCI is not set
# CONFIG_USB is not set
# CONFIG_TOOLS_LIBCRYPTO is not set
# CONFIG_TOOLS_MKEFICAPSULE is not set
# CONFIG_TOOLS_KWBIMAGE is not set
```
